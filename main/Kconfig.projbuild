## main/Kconfig.projbuild
```kconfig
menu "TriageBox Station"

    config TB_STATION_NUM
        int "Station number (1-20) -- CHANGE THIS PER BOARD"
        range 1 20
        default 1
        help
            The one value that must differ between two physical stations. It is
            the source of every identity that collides silently:

              LoRa radio address        = this number
              static IP last octet      = 10 + this number  (.11, .12, .13, ...)
              MQTT node id offset       = (this number - 1) * 20

            Two boards flashed with the same number fight over the LoRa channel
            and, with static addressing, over the same IP -- neither of which
            produces an error message. Getting TB_STATION_ID wrong is loud by
            comparison: the backend logs an unknown station and the dashboard
            shows it as awaiting adoption.

            Keep TB_STATION_ID in step with this by convention (num 3 -> st-03),
            but the two are independent: the string is whatever the backend has
            registered.

    config TB_STATION_ID
        string "Station ID (MQTT topic segment)"
        default "st-01"
        help
            Becomes {station_id} in triagebox/{station_id}/{node_id}/vital.
            The backend drops packets from unregistered station IDs, but the
            station also publishes triagebox/{station_id}/announce on connect,
            so an unregistered station shows up in the dashboard as awaiting
            adoption rather than vanishing. Demo seeds are st-01 and st-02.

    config TB_POLL_PERIOD_MS
        int "LoRa poll cycle period (ms)"
        range 1000 60000
        default 15000
        help
            One full cycle: the station polls nodes 1..TB_NODE_COUNT, then waits
            until this much time has passed since the cycle STARTED. 15000 is
            the deployment value and matches the nominal MQTT vital cadence
            one-for-one, so the station publishes exactly what it polls with no
            decimation anywhere.

            LOWER IT ONLY FOR A RANGE TEST, and know what you are trading. With
            one node the floor is a single slot (LORA_POLL_SLOT_MS, 250ms), so
            2000-3000 is comfortable and gives a walking operator a fresh
            success/miss verdict every few metres instead of every 15 seconds --
            at 15000 you cover 50m between data points and cannot tell where the
            link actually died.

            What it costs: airtime duty cycle scales inversely. A 5-byte poll is
            ~30ms of air, so 20 nodes at 15000 is ~4% duty, under the 10%
            ceiling common on this band. The same 20 nodes at 3000 would be ~20%
            and is NOT legal to leave running -- with 20 nodes do not go below
            8000. The 1000 floor exists for single-node bench work only.

            Set it back to 15000 before deploying. Nothing enforces this at
            runtime; the station logs the value it is using at startup.

    config TB_NODE_COUNT
        int "Nodes to poll each cycle (1-20)"
        range 1 20
        default 1
        help
            The station polls node addresses 1..N in order, once per cycle.
            Keep this at the number of nodes that actually exist: every
            configured-but-absent node costs a full slot of dead air waiting
            for a reply that never comes.

    config TB_POLL_LOG_EVERY
        bool "Log every poll verdict (range testing)"
        default n
        help
            One INFO line per poll: "node N OK rssi .. snr .." or
            "node N MISS". This is the packet-level record a walking range
            test needs -- PDR is OK-lines divided by total lines per segment
            of the walk, and the rssi/snr in the line is the uplink quality
            measured by the station, which the node's own Test screen cannot
            see. At one node and a 2-3s period this is a readable verdict
            every few metres.

            Leave it OFF for deployment: 20 nodes at 15000ms would emit ~1.3
            lines per second even when everything is healthy, burying the
            online/offline transitions and MQTT warnings that matter. With
            the flag off, poll behaviour is exactly as before -- silent.

    config TB_ETH_STATIC_IP
        bool "Use a static IP instead of DHCP"
        default y
        help
            Static is the default because the deployment has no DHCP server: a
            direct cable to a PC runs none, and neither does the unmanaged switch
            that a multi-station field setup uses. Windows desktop cannot supply
            one either -- the DHCP server role is Windows Server only, and
            Internet Connection Sharing forces the fixed 192.168.137.x subnet.

            The address is DERIVED from TB_STATION_NUM (see TB_ETH_SUBNET below),
            not configured per board, so two stations cannot be flashed onto the
            same address by forgetting a field. Turn this off only when plugging
            into a router that does run DHCP.

    config TB_ETH_SUBNET
        string "Static subnet prefix (first three octets)"
        depends on TB_ETH_STATIC_IP
        default "192.168.50"
        help
            The station's address is <prefix>.(10 + TB_STATION_NUM), so station 1
            is 192.168.50.11 and station 2 is .12. The gateway is <prefix>.1,
            which is also where the broker runs on a direct-cable bench -- set
            the PC's adapter to that address with mask 255.255.255.0.

            No DNS is configured, so the broker URI must be an IP literal.
            Offset 10 keeps the low addresses free for the PC and any switch.

    config TB_MQTT_URI
        string "MQTT broker URI"
        default "mqtt://192.168.50.1:1883"
        help
            Full URI including scheme and port, e.g. mqtt://host:1883.

    config TB_MQTT_USERNAME
        string "MQTT username (empty for none)"
        default ""

    config TB_MQTT_PASSWORD
        string "MQTT password (empty for none)"
        default ""

endmenu
```
